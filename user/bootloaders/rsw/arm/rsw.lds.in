/*
 * $FILE$
 * 
 * ld script to build the arm version
 * 
 * $VERSION$
 *
 * Author: Miguel Masmano <mmasmano@fentiss.com>
 * Author: Manuel Muñoz      <mmunoz@ai2.upv.es>
 * Author: Javier O. Coronel <jcoronel@fentiss.com>
 *
 * $LICENSE:
 * COPYRIGHT (c) Fent Innovative Software Solutions S.L.
 *     Read LICENSE file for the license terms.
 */
/*
 * Changelog:
 * - [08/09/16:XM-ARM-2:SPR-150608-03:#57] Force RSW entry point position to CONFIG_RDONLY_SEC_ADDR.
 */

#include <config.h>

#ifdef arm
#undef arm
#endif
/*OUTPUT_FORMAT("arm-elf", "arm-elf", "arm-elf")*/
OUTPUT_ARCH(arm)
ENTRY(_start)

SECTIONS
{
  . = CONFIG_RDONLY_SEC_ADDR;	// START_ADDR
  _srorsw = .;
  start = .;
  .text ALIGN (0x1000): {  	
	*(.text.traptab)
  	*(.text)
	. = ALIGN(8);
	xmefContainerPtr = . ;
#ifndef CONFIG_STAND_ALONE
	LONG(_scontainer);
#else
	LONG(CONFIG_CONTAINER_ADDR);
#endif
  }

  .rodata ALIGN (8) : {
	*(.rodata)
  	*(.rodata.*)
	*(.rodata.*.*)
  }

#ifndef CONFIG_STAND_ALONE
#ifdef CONFIG_CONTAINER_AT_FIXED_ADDR
  prev = .;
  . = CONFIG_CONTAINER_ADDR;
#endif
  .container ALIGN(8) : {
    	     _scontainer = . ;
  	     *(.container)
  }

#ifdef CONFIG_CONTAINER_AT_FIXED_ADDR
  . = prev;
#endif
#endif

  _erorsw = .;

  . = CONFIG_RW_SEC_ADDR;	// DATA_ADDR
  _srsw = .;

  .data ALIGN (8) : AT ( ADDR (.container) + SIZEOF (.container)) {
        _sdata = .;
	_sdata_lma = LOADADDR(.data); 
	*(.data)
	_edata = .;
  }
  
  .bss ALIGN (8) : {
       _sbss = .;
       *(COMMON)
       *(.bss)
       _ebss = .;
  }

   _ersw = .;

  /DISCARD/ :
  {
	*(.note)
	*(.comment*)
  }
}
