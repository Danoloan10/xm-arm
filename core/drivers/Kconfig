## core/drivers/Kconfig
```kconfig
# Changelog:
# - [18/11/2015:SPR-151118-01:#93] CONFIG_EARLY_CPU_MHZ tag is not needed for ZYNQ boards
# - [18/11/2015:SPR-151118-01:#93] Early Uart configuration inside a menu
# - [16/06/2016:CP-160616-01:#113] Add Uart clock freq configuration.
menu "Drivers"

config DEV_UART
       tristate "Enable UART driver"
       depends on LEON2 || LEON3 || LEON4 || ZYNQ
       default y

config DEV_UART_0
       bool "Reserve UART0"
       default "y"
       depends on DEV_UART

config DEV_UART_1
       bool "Reserve UART1"
       default "y"
       depends on DEV_UART

config XPAR_PS7_UART_0_UART_CLK_FREQ_HZ
       int "XPAR_PS7_UART_0_UART_CLK_FREQ_HZ - UART 0 Reference Clock (Hz)"
       depends on (DEV_UART&&DEV_UART_0&&ZYNQ)
       default 50000000

config XPAR_PS7_UART_1_UART_CLK_FREQ_HZ
       int "XPAR_PS7_UART_1_UART_CLK_FREQ_HZ - UART 1 Reference Clock (Hz)"
       depends on (DEV_UART&&DEV_UART_1&&ZYNQ)
       default 50000000

config EARLY_OUTPUT
       bool "Enable early output"
       depends on (DEV_UART&&(LEON2||LEON3||LEON4||ZYNQ))
       default n

if EARLY_OUTPUT
menu   "Early UART Configuration"
choice
        prompt "Select early UART port"
        default EARLY_UART1
        depends on EARLY_OUTPUT&&(LEON2||LEON3||LEON4||ZYNQ)

config EARLY_UART0
       bool "UART0"
       depends on DEV_UART_0

config EARLY_UART1
       bool "UART1"
       depends on DEV_UART_1

endchoice

config EARLY_UART_BAUDRATE
       int "Early UART baudrate"
       depends on EARLY_OUTPUT&&(LEON2||LEON3||LEON4||ZYNQ)
       default 115200

endmenu
endif

config DEV_UART_FLOWCONTROL
       bool "Enable UART flow control"
       depends on (DEV_UART && !ZYNQ) 
       default y

config UART_ADD_CARRIAGE_RETURN
       bool "Enable the addition of a carriage return at the end of the line."
       depends on (DEV_UART_0 || DEV_UART_1)
       default y

config DEV_NO_UARTS
       int
       default "2"
       depends on DEV_UART

config UART_THROUGH_DSU
       bool "DSU samples UART port"
       depends on (LEON2 || LEON3||LEON4) && !(TSIM||ZYNQ)

config DEV_MEMBLOCK
       tristate "Enable memory block driver"
       default y

endmenu
```

## core/kernel/Kconfig
```kconfig
config EXPERIMENTAL
       bool "Enable experimental features"
       default n

config ASSERT
       bool "Enable assertions"
       default y

menuconfig DEBUG
	   bool "Debug and profiling support"
	   default y
	   
if DEBUG
config VERBOSE_TRAP
       bool "Dump CPU state when a trap is raised"
       default y

config DEBUG_HYPERCALL
       bool "Verbose hypercalls execution"
       default n
endif

config NO_GCC_OPT
       bool
       default n

config ID_STRING_LENGTH
       int "Max. identifier length (B)"
       default "16"

menu "Hypervisor"

config VOLUNTARY_PREEMPTION
       bool "Enable voluntary preemption support"
       default "n"
       depends on EXPERIMENTAL

config KSTACK_KB
       int "Kernel stack size (KB)"
       default "8"

config NO_VCPUS
       int "Number of virtual CPUs"
       default "1"

config MAX_NO_IPVI
       int "Number of IPVIs"
       default "4"

config MAX_NO_MAREAS
       int
       default "8"

config PLAN_EXTSYNC
       bool "Enable external synchronisation"
       default "n"

config AUDIT_EVENTS     
       bool "Enable kernel audit events"
       default "n"
  
menu "L1 cache policy for XM"   
choice
       prompt "Select XM Data section cache policy"
       default DCACHE_L1_POLICY_WB_WA
       depends on ENABLE_CACHE

config DCACHE_L1_POLICY_WB_WA
       bool "Write-back/write-allocate"
       --help---
       Select this for a write-back/write-allocate L1 cache policy for XM Data section.
       
config DCACHE_L1_POLICY_UNCACHEABLE
       bool "Uncacheable"
       --help---
       Select this for a non-cacheable L1 cache policy for XM Data section.
       
endchoice
          
choice
       prompt "Select XM Code section cache policy"
       default ICACHE_L1_POLICY_WB_WA
       depends on ENABLE_CACHE

config ICACHE_L1_POLICY_WB_WA
       bool "Write-back/write-allocate"
       --help---
       Select this for a write-back/write-allocate L1 cache policy for XM Code section.

config ICACHE_L1_POLICY_WT_NWA
       bool "Write-through/no write-allocate"
       --help---
       Select this for a write-through/no write-allocate L1 cache policy for XM Code section.
       
config ICACHE_L1_POLICY_WB_NWA
       bool "Write-back/no write-allocate"
       --help---
       Select this for a write-back/no write-allocate L1 cache policy for XM Code section.
       
endchoice
endmenu 
 
      
choice
       prompt "Select L1 cache policy for partitions"
       default CACHE_L1_PARTITION_POLICY_WB_WA
       depends on ENABLE_CACHE

config CACHE_L1_PARTITION_POLICY_WB_WA
       bool "Write-back/write-allocate"
       --help---
       Select this for a write-back/write-allocate L1 cache policy for partitions.

config CACHE_L1_PARTITION_POLICY_WT_NWA
       bool "Write-through/no write-allocate"
       --help---
       Select this for a write-through/no write-allocate L1 cache policy for partitions.
       
config CACHE_L1_PARTITION_POLICY_WB_NWA
       bool "Write-back/no write-allocate"
       --help---
       Select this for a write-back/no write-allocate L1 cache policy for partitions.
       
endchoice
       
endmenu

source "Kconfig.ver"

if MMU
source "kernel/mmu/Kconfig"
endif

if MPU
source "kernel/mpu/Kconfig"
endif

source "klibc/Kconfig"

source "drivers/Kconfig"
source "objects/Kconfig"
```

## core/kernel/arm/Kconfig
```kconfig
 # Changelog:
 # [10/12/15:XM-ARM-2:SPR-150715-03:#73] Add cache enable label.
 # [16/06/16:CP-160616-01:#113] Add ZYNQ ZC7030 board into configuration.


mainmenu "XM Configuration"

  ############
 # ARCH DEF #
############
config ARM
       def_bool y

config HWIRQ_PRIO_LBS
       def_bool y

#config ARCH_MMU_BYPASS
#	def_bool y

#config HWIRQ_PRIO_FBS
#       def_bool y

  ########
 # IRQS #
########
config NO_HWIRQS
       int
       default "96" if ZYNQ

  ##############
 # ENDIANNESS #
##############
config TARGET_LITTLE_ENDIAN
       depends on ZYNQ
       def_bool y       

  #############
 # PROCESSOR #
#############
menu "Processor"

choice
     prompt "ARM cpu"
     default CORTEX_A9
config CORTEX_A9
       bool "Cortex-A9"
       --help---
	Select this for a Cortex-A9 processor.
endchoice

  ############
 # PLATFORM #
############
choice
     prompt "Board"
     default ZEDBOARD_BOARD
config ZEDBOARD_BOARD
       bool "ZEDBOARD"
       --help---
       Select this for Xilinx ZedBoard Xilinx Zynq-7000.
config ZC706_BOARD
       bool "ZYNQ ZC706"
       --help---
       Select this for Xilinx Zynq-7000 All Programmable SoC ZC706 Evaluation Kit.
config ZC7030_BOARD
       bool "ZYNQ ZC7030"
       --help---
       Select this for Xilinx Zynq-7000 All Programmable SoC ZC7030.
config OVPSIM
       bool "Imperas Simulator - OVPSIM"
       --help---
       Select this for a Simulated Platform using Imperas OVPSim.
endchoice

  ###################
 # SIMULATED BOARD #
###################
choice
	prompt "Simulated Board"
	default ZEDBOARD_SIM
	depends on OVPSIM

config ZEDBOARD_SIM
       bool "ZEDBOARD"
       --help---
       Select this for a SIMULATED ZedBoard Xilinx Zynq-7000.
config ZC706_SIM
       bool "ZC706"
       --help---
       Select this for a SIMULATED Zynq-7000 All Programmable SoC ZC706.
config ZC7030_SIM
       bool "ZC7030"
       --help---
       Select this for a SIMULATED Zynq-7000 All Programmable SoC ZC7030.
endchoice

  #########
 # BOARD #
#########
config ZEDBOARD
	def_bool y
	depends on ZEDBOARD_SIM||ZEDBOARD_BOARD

config ZC706
    def_bool y
    depends on ZC706_SIM||ZC706_BOARD

config ZC7030
    def_bool y
    depends on ZC7030_SIM||ZC7030_BOARD

config ZYNQ
    def_bool y
    depends on ZEDBOARD||ZC706||ZC7030

  #################
 # COOPROCESSORS #
#################
config VFP_EXTENSION
       def_bool y
       depends on ZYNQ

  #######################
 # MULTIPROCESSOR DEFS #
#######################

choice
     prompt "Multicore support"
     default MULTICORE_SUPPORT_DISABLED
config MULTICORE_SUPPORT_DISABLED
       bool "None"
       --help---
       Select this to disable multicore support.
#config AMP_SUPPORT
#       bool "AMP support"
#       --help---
#	Select this to enable AMP support.
config SMP_SUPPORT
       bool "SMP support"
       --help---
	Select this to enable SMP support.
endchoice

config NO_CPUS
       int "Number of CPUs supported"
       default "2" if (ZEDBOARD)
       default "1" if (!ZEDBOARD)
       depends on SMP_SUPPORT

config MULTICORE_SUPPORT
       bool
       default "n" if (!AMP_SUPPORT&&!SMP_SUPPORT)
       default "y" if (AMP_SUPPORT||SMP_SUPPORT)

  #########################
 # MEMORY PROTECTION SYS #
#########################

config MMU
       def_bool y
       depends on ZYNQ

#config WATCHDOG
#       bool "Enable watchdog"
#       default n
#       depends on SPW_RTC

#config WATCHDOG_NMAF
#       int "Reset watchdog every N MAFs"
#       default 1
#       depends on WATCHDOG

#config WATCHDOG_TIMEOUT
#       int "Watchdog timeout"
#       default 5000000
#       depends on WATCHDOG        

#config AMBA_BUS_PNP
#        bool "Support AMBA bus PnP"
#        default y
#        depends on LEON3||LEON4

#config UART_TIMEOUT
#       int
#       default 500 if !UART_THROUGH_DSU
#       default 120000 if UART_THROUGH_DSU

config ENABLE_CACHE
       def_bool y
       depends on ZYNQ

config ENABLE_CACHE_L2
       bool "Enable L2 cache"
       default y
       depends on ENABLE_CACHE

choice
       prompt "Select L2 cache policy"
       default CACHE_L2_POLICY_WB_WA
       depends on ENABLE_CACHE_L2

config CACHE_L2_POLICY_WB_WA
       bool "Write-back/write-allocate"
       --help---
       Select this for a write-back/write-allocate L2 cache policy.

config CACHE_L2_POLICY_WT_NWA
       bool "Write-through/no write-allocate"
       --help---
       Select this for a write-through/no write-allocate L2 cache policy.
       
config CACHE_L2_POLICY_WB_NWA
       bool "Write-back/no write-allocate"
       --help---
       Select this for a write-back/no write-allocate L2 cache policy.

endchoice


#config ENABLE_CACHE
#       bool "Enable cache"
#       default y

#config CACHE_SNOOP
#       bool "Enable cache snoop"
#       depends on ENABLE_CACHE
#       default y

#config CACHE_IBURST_FETCH
#       bool "Enable instruction burst fetch"
#       depends on ENABLE_CACHE
#       default y

#config FLUSH_CACHE_AFTER_CS
#       bool "Flush cache after context switch"
#       depends on ENABLE_CACHE
#       default y

#choice
#        prompt "Select L2 cache write policy"
#        default COPY_BACK
#        depends on ENABLE_CACHE

#config COPY_BACK
#       bool "Copy-back"

#config WRITE_THROUGH
#       bool "Write-through"

#endchoice

#config WA_PROTECT_MMAP_PREG_WPOINT
#       def_bool y
#       depends on GR_CPCI_AT697E

endmenu

menu "Physical memory layout"
config XM_LOAD_ADDR
       hex "XM load address"
       default "0x20000000" if ZYNQ

config XM_LOAD_DATA_ADDR
       hex "XM load data address"
       default "0x21000000" if ZYNQ


config XM_OFFSET
       hex "XM virtual address"
       default XM_LOAD_ADDR if !MMU
       default "0x20000000" if (MMU && ZYNQ)

endmenu

source "kernel/Kconfig"
```

## user/bootloaders/rsw/arm/Kconfig
```kconfig
# - [18/11/2015:SPR-151118-01:#93] CONFIG_UART_FLOWCONTROL tag is not available for ZYNQ boards
# - [18/11/2015:SPR-151118-01:#93] Early Uart configuration inside a menu
# - [15/12/2015:SPR-150527-01:#51] Add tag XM_LOAD_DATA_SIZE. Size of data to be zeroed before load XM.
# - [16/06/2016:CP-160616-01:#113] Add Uart clock freq configuration.

mainmenu "RSW Configuration"

source "Kconfig"

menu "RSW memory layout"

config CONTAINER_ADDR
       hex "Container physical location address"
       default "0x00300000"
       depends on STAND_ALONE||CONTAINER_AT_FIXED_ADDR

config RDONLY_SEC_ADDR
       hex "Read-only section addresses"
       default "0x00100000"

config RW_SEC_ADDR
       hex "Read/write section addresses"
       default "0x00200000"

endmenu

config XM_LOAD_DATA_SIZE
	   hex
	   default "0x00000400"

config CPU_FREQ_AUTO
       bool "Autodetect CPU frequency"
       default y

config CPU_KHZ
       int "CPU frequency (KHz)"
       default "400000"
       depends on OUTPUT_ENABLED&&!CPU_FREQ_AUTO

config OUTPUT_ENABLED
       bool "Enable RSW output"
       default y

if OUTPUT_ENABLED
menu "UART Configuration"
choice
	prompt "Enable UART support"
	default UART1
        depends on OUTPUT_ENABLED

config UART0
       bool "UART0"
config UART1
       bool "UART1"
endchoice

config UART_BAUDRATE
       int "UART baud rate"
       default "115200"
       depends on OUTPUT_ENABLED

config XPAR_PS7_UART_0_UART_CLK_FREQ_HZ
       int "UART 0 Reference Clock (Hz)"
       depends on (OUTPUT_ENABLED&&UART0)
       default 50000000

config XPAR_PS7_UART_1_UART_CLK_FREQ_HZ
       int "UART 1 Reference Clock (Hz)"
       depends on (OUTPUT_ENABLED&&UART1)
       default 50000000

endmenu

endif
```

## user/xal/common/Kconfig
```kconfig
source "../../core/Kconfig.ver"

config DEBUG
       bool "Debug"
       default n

config MEMORY_MANAGER
       bool "Memory manager"
	   default y

if MEMORY_MANAGER
config BLOCK_BYTE_ORDER
       int "Block byte order (2^k B per block)"
	   default "6"

endif

menu "Kernel options"
config STACK_KB
       int "Stack size (KB)"
       default "8"

config STACK_EXCPT_KB
       int "Stack size for exceptions (KB)"
       default "1"

endmenu
```
